## sdkconfig.defaults
```kconfig
# --- ESP32-S3 / PSRAM ---
CONFIG_IDF_TARGET="esp32s3"
CONFIG_ESPTOOLPY_FLASHSIZE_16MB=y
CONFIG_SPIRAM=y
CONFIG_SPIRAM_MODE_OCT=y
CONFIG_SPIRAM_SPEED_80M=y
CONFIG_SPIRAM_FETCH_INSTRUCTIONS=y
CONFIG_SPIRAM_RODATA=y
# WiFi/LWIP-Puffer ins PSRAM -> internen RAM für den TLS-Handshake (wss) freihalten
# (sonst: "Dynamic Impl: alloc failed" / SSL_ALLOC_FAILED beim wss-Connect)
CONFIG_SPIRAM_TRY_ALLOCATE_WIFI_LWIP=y

# --- Partition table ---
CONFIG_PARTITION_TABLE_CUSTOM=y
CONFIG_PARTITION_TABLE_CUSTOM_FILENAME="partitions.csv"

# --- FreeRTOS / perf ---
CONFIG_FREERTOS_HZ=1000
CONFIG_ESP_DEFAULT_CPU_FREQ_MHZ_240=y

# --- Bluetooth aus: Provisioning läuft seit Task 3 über SoftAP + Captive Portal ---
CONFIG_BT_ENABLED=n

# --- SoftAP Captive Portal: HTTP-Server braucht etwas mehr Header-Platz ---
CONFIG_HTTPD_MAX_REQ_HDR_LEN=1024

# --- WebSocket client TLS ---
CONFIG_ESP_TLS_INSECURE=n
# mbedtls aus dem PSRAM allozieren -> kein "alloc failed" im wss-Handshake
# (interner RAM ist durch LVGL-DMA-Puffer + WiFi knapp).
# Dynamic-Buffer MUSS dafür aus sein, sonst erzwingt es interne Allokation.
CONFIG_MBEDTLS_DYNAMIC_BUFFER=n
CONFIG_MBEDTLS_EXTERNAL_MEM_ALLOC=y
# CA-Bundle für wss://-Zertifikatsprüfung (esp_crt_bundle_attach)
CONFIG_MBEDTLS_CERTIFICATE_BUNDLE=y
CONFIG_MBEDTLS_CERTIFICATE_BUNDLE_DEFAULT_FULL=y

# --- LVGL (v9 managed component) ---
# Framebuffer liegt in PSRAM (vom waveshare_bsp via esp_lvgl_port gesetzt).
CONFIG_LV_COLOR_DEPTH_16=y
# QR-Code-Widget für das Captive-Portal-Provisioning (Task 3).
CONFIG_LV_USE_QRCODE=y
```
